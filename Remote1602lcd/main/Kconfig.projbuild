## Remote1602lcd/main/Kconfig.projbuild
```kconfig
menu "Application configuration"

	config GPIO_RANGE_MAX
		int
		default 33 if IDF_TARGET_ESP32
		default 46 if IDF_TARGET_ESP32S2
		default 48 if IDF_TARGET_ESP32S3
		default 18 if IDF_TARGET_ESP32C2
		default 19 if IDF_TARGET_ESP32C3
		default 30 if IDF_TARGET_ESP32C6

	menu "WiFi Setting"

		config ESP_WIFI_SSID
			string "WiFi SSID"
			default "myssid"
			help
				SSID (network name) for the example to connect to.

		config ESP_WIFI_PASSWORD
			string "WiFi Password"
			default "mypassword"
			help
				WiFi password (WPA or WPA2) for the example to use.

		config ESP_MAXIMUM_RETRY
			int "Maximum retry"
			default 5
			help
				Set the Maximum retry to avoid station reconnecting to the AP unlimited when the AP is really inexistent.

		config UDP_LISTEN_PORT
			int "UDP Listen Port"
			range 0 65535
			default 8080
			help
				Local port UDP server will listen on.

	endmenu


	menu "Device Setting"

		config RS_GPIO
			int "HD44780 RS GPIO number"
			range 0 GPIO_RANGE_MAX
			default 19 if IDF_TARGET_ESP32
			default  1 if IDF_TARGET_ESP32S2 || IDF_TARGET_ESP32S3
			default  0 # C3 and others
			help
				GPIO number (IOxx) to HD44780 RS.

		config E_GPIO
			int "HD44780 E GPIO number"
			range 0 GPIO_RANGE_MAX
			default 18 if IDF_TARGET_ESP32
			default  2 if IDF_TARGET_ESP32S2 || IDF_TARGET_ESP32S3
			default  1 # C3 and others
			help
				GPIO number (IOxx) to HD44780 E.

		config D4_GPIO
			int "HD44780 D4 GPIO number"
			range 0 GPIO_RANGE_MAX
			default  5 if IDF_TARGET_ESP32
			default  3 if IDF_TARGET_ESP32S2 || IDF_TARGET_ESP32S3
			default  2 # C3 and others
			help
				GPIO number (IOxx) to HD44780 D4.

		config D5_GPIO
			int "HD44780 D5 GPIO number"
			range 0 GPIO_RANGE_MAX
			default 17 if IDF_TARGET_ESP32
			default  4 if IDF_TARGET_ESP32S2 || IDF_TARGET_ESP32S3
			default  3 # C3 and others
			help
				GPIO number (IOxx) to HD44780 D5.

		config D6_GPIO
			int "HD44780 D6 GPIO number"
			range 0 GPIO_RANGE_MAX
			default 16 if IDF_TARGET_ESP32
			default  5 if IDF_TARGET_ESP32S2 || IDF_TARGET_ESP32S3
			default  4 # C3 and others
			help
				GPIO number (IOxx) to HD44780 D6.

		config D7_GPIO
			int "HD44780 D7 GPIO number"
			range 0 GPIO_RANGE_MAX
			default  4 if IDF_TARGET_ESP32
			default  6 if IDF_TARGET_ESP32S2 || IDF_TARGET_ESP32S3
			default  5 # C3 and others
			help
				GPIO number (IOxx) to HD44780 D7.

		config BL_GPIO
			int "HD44780 BL GPIO number"
			range -1 GPIO_RANGE_MAX
			default -1
			help
				GPIO number (IOxx) to HD44780 BL.

	endmenu

endmenu
```

## main/Kconfig.projbuild
```kconfig
menu "TEA5767 Configuration"

	config GPIO_RANGE_MAX
		int
		default 33 if IDF_TARGET_ESP32
		default 46 if IDF_TARGET_ESP32S2
		default 19 if IDF_TARGET_ESP32C3
		default 48 if IDF_TARGET_ESP32S3

	config SCL_GPIO
		int "SCL GPIO number"
		range 0 GPIO_RANGE_MAX
		default 22 if IDF_TARGET_ESP32
		default 4  if IDF_TARGET_ESP32S2
		default 4  if IDF_TARGET_ESP32S3
		default 19 if IDF_TARGET_ESP32C3
		help
			GPIO number (IOxx) to I2C SCL.
			Some GPIOs are used for other purposes (flash connections, etc.) and cannot be used to I2C.
			GPIOs 35-39 are input-only so cannot be used as outputs.

	config SDA_GPIO
		int "SDA GPIO number"
		range 0 GPIO_RANGE_MAX
		default 21 if IDF_TARGET_ESP32
		default 3  if IDF_TARGET_ESP32S2
		default 3  if IDF_TARGET_ESP32S3
		default 18 if IDF_TARGET_ESP32C3
		help
			GPIO number (IOxx) to I2C SDA.
			Some GPIOs are used for other purposes (flash connections, etc.) and cannot be used to I2C.
			GPIOs 35-39 are input-only so cannot be used as outputs.

	choice FM_BAND
		bool "Select your location"
		default FM_BAND_US
		help
			Select your location.

		config FM_BAND_US
			bool "US/Europe (87.5 MHz to 108 MHz)"
		config FM_BAND_JP
			bool "Japan (76 MHz to 91 MHz)"
	endchoice

endmenu
```

## to1602lcd/main/Kconfig.projbuild
```kconfig
menu "Application configuration"

	config GPIO_RANGE_MAX
		int
		default 33 if IDF_TARGET_ESP32
		default 46 if IDF_TARGET_ESP32S2
		default 48 if IDF_TARGET_ESP32S3
		default 18 if IDF_TARGET_ESP32C2
		default 19 if IDF_TARGET_ESP32C3
		default 30 if IDF_TARGET_ESP32C6


	config RS_GPIO
		int "HD44780 RS GPIO number"
		range 0 GPIO_RANGE_MAX
		default 19 if IDF_TARGET_ESP32
		default  1 if IDF_TARGET_ESP32S2 || IDF_TARGET_ESP32S3
		default  0 # C3 and others
		help
			GPIO number (IOxx) to HD44780 RS.

	config E_GPIO
		int "HD44780 E GPIO number"
		range 0 GPIO_RANGE_MAX
		default 18 if IDF_TARGET_ESP32
		default  2 if IDF_TARGET_ESP32S2 || IDF_TARGET_ESP32S3
		default  1 # C3 and others
		help
			GPIO number (IOxx) to HD44780 E.

	config D4_GPIO
		int "HD44780 D4 GPIO number"
		range 0 GPIO_RANGE_MAX
		default  5 if IDF_TARGET_ESP32
		default  3 if IDF_TARGET_ESP32S2 || IDF_TARGET_ESP32S3
		default  2 # C3 and others
		help
			GPIO number (IOxx) to HD44780 D4.

	config D5_GPIO
		int "HD44780 D5 GPIO number"
		range 0 GPIO_RANGE_MAX
		default 17 if IDF_TARGET_ESP32
		default  4 if IDF_TARGET_ESP32S2 || IDF_TARGET_ESP32S3
		default  3 # C3 and others
		help
			GPIO number (IOxx) to HD44780 D5.

	config D6_GPIO
		int "HD44780 D6 GPIO number"
		range 0 GPIO_RANGE_MAX
		default 16 if IDF_TARGET_ESP32
		default  5 if IDF_TARGET_ESP32S2 || IDF_TARGET_ESP32S3
		default  4 # C3 and others
		help
			GPIO number (IOxx) to HD44780 D6.

	config D7_GPIO
		int "HD44780 D7 GPIO number"
		range 0 GPIO_RANGE_MAX
		default  4 if IDF_TARGET_ESP32
		default  6 if IDF_TARGET_ESP32S2 || IDF_TARGET_ESP32S3
		default  5 # C3 and others
		help
			GPIO number (IOxx) to HD44780 D7.

	config BL_GPIO
		int "HD44780 BL GPIO number"
		range -1 GPIO_RANGE_MAX
		default -1
		help
			GPIO number (IOxx) to HD44780 BL.

endmenu
```

## toRemoteDisplay/main/Kconfig.projbuild
```kconfig
menu "Application configuration"

	config ESP_WIFI_SSID
		string "WiFi SSID"
		default "myssid"
		help
			SSID (network name) for the example to connect to.

	config ESP_WIFI_PASSWORD
		string "WiFi Password"
		default "mypassword"
		help
			WiFi password (WPA or WPA2) for the example to use.

	config ESP_MAXIMUM_RETRY
		int "Maximum retry"
		default 5
		help
			Set the Maximum retry to avoid station reconnecting to the AP unlimited when the AP is really inexistent.

	choice UDP_ADDRESS
		bool "Select UDP Addrss"
		default UDP_DIRECTED_BROADCAST
		help
			Select Send Addrss.
		config UDP_LIMITED_BROADCAST
			bool "Limited broadcast address"
		config UDP_DIRECTED_BROADCAST
			bool "Directed broadcast address"
		config UDP_MULTICAST
			bool "Multicast address"
		config UDP_UNICAST
			bool "Unicast address"
	endchoice

	config UDP_MULTICAST_ADDRESS
		depends on UDP_MULTICAST
		string "Multicast address"
		default "239.255.255.255"

	config UDP_UNICAST_ADDRESS
		depends on UDP_UNICAST
		string "Unicast address"
		default "192.168.10.20"

	config UDP_PORT
		int "UDP Port"
		range 1024 65535
		default 8080
		help
			Port to send data output to

endmenu
```

## withGaradeDoorRemote+WiFi/main/Kconfig.projbuild
```kconfig
menu "Application Configuration"

	config RF_GPIO_RANGE_MAX
		int
		default 33 if IDF_TARGET_ESP32
		default 46 if IDF_TARGET_ESP32S2
		default 48 if IDF_TARGET_ESP32S3
		default 18 if IDF_TARGET_ESP32C2
		default 19 if IDF_TARGET_ESP32C3
		default 30 if IDF_TARGET_ESP32C6

	config RF_GPIO
		int "GPIO number to RF data"
		range 0 RF_GPIO_RANGE_MAX
		default 4
		help
			GPIO number (IOxx) to RF data.
			Some GPIOs are used for other purposes (flash connections, etc.) and cannot be used to MOSI.
			On the ESP32, GPIOs 35-39 are input-only so cannot be used as outputs.
			On the ESP32-S2, GPIO 46 is input-only so cannot be used as outputs.

	choice OPERATION
		prompt "Operation"
		default TEACHING
		help
			Select operation.
		config TEACHING
			bool "Teaching"
			help
				Work As teaching.
		config RADIO
			bool "Radio"
			help
				Work as radio.
	endchoice

	config ESP_WIFI_SSID
		depends on RADIO
		string "WiFi SSID"
		default "myssid"
		help
			SSID (network name) for the example to connect to.

	config ESP_WIFI_PASSWORD
		depends on RADIO
		string "WiFi Password"
		default "mypassword"
		help
			WiFi password (WPA or WPA2) for the example to use.

	config ESP_MAXIMUM_RETRY
		depends on RADIO
		int "Maximum retry"
		default 5
		help
			Set the Maximum retry to avoid station reconnecting to the AP unlimited when the AP is really inexistent.

	choice UDP_ADDRESS
		depends on RADIO
		bool "Select UDP Addrss"
		default UDP_DIRECTED_BROADCAST
		help
			Select Send Addrss.
		config UDP_LIMITED_BROADCAST
			bool "Limited broadcast address"
		config UDP_DIRECTED_BROADCAST
			bool "Directed broadcast address"
		config UDP_MULTICAST
			bool "Multicast address"
		config UDP_UNICAST
			bool "Unicast address"
	endchoice

	config UDP_MULTICAST_ADDRESS
		depends on RADIO
		depends on UDP_MULTICAST
		string "Multicast address"
		default "239.255.255.255"

	config UDP_UNICAST_ADDRESS
		depends on RADIO
		depends on UDP_UNICAST
		string "Unicast address"
		default "192.168.10.20"

	config UDP_PORT
		depends on RADIO
		int "UDP Port"
		range 1024 65535
		default 8080
		help
			Port to send data output to

endmenu
```

## withGaradeDoorRemote/main/Kconfig.projbuild
```kconfig
menu "Application Configuration"

	config RF_GPIO_RANGE_MAX
		int
		default 33 if IDF_TARGET_ESP32
		default 46 if IDF_TARGET_ESP32S2
		default 48 if IDF_TARGET_ESP32S3
		default 18 if IDF_TARGET_ESP32C2
		default 19 if IDF_TARGET_ESP32C3
		default 30 if IDF_TARGET_ESP32C6

	config RF_GPIO
		int "GPIO number to RF data"
		range 0 RF_GPIO_RANGE_MAX
		default 4
		help
			GPIO number (IOxx) to RF data.
			Some GPIOs are used for other purposes (flash connections, etc.) and cannot be used to MOSI.
			On the ESP32, GPIOs 35-39 are input-only so cannot be used as outputs.
			On the ESP32-S2, GPIO 46 is input-only so cannot be used as outputs.

	choice OPERATION
		prompt "Operation"
		default TEACHING
		help
			Select operation.
		config TEACHING
			bool "Teaching"
			help
				Work As teaching.
		config RADIO
			bool "Radio"
			help
				Work as radio.
	endchoice


endmenu
```

## withNetwork/main/Kconfig.projbuild
```kconfig
menu "Application configuration"

	menu "WiFi Setting"

		config ESP_WIFI_SSID
			string "WiFi SSID"
			default "myssid"
			help
				SSID (network name) to connect to.

		config ESP_WIFI_PASSWORD
			string "WiFi Password"
			default "mypassword"
			help
				WiFi password (WPA or WPA2) to connect to.

		config ESP_MAXIMUM_RETRY
			int "Maximum retry"
			default 5
			help
				Set the Maximum retry to avoid station reconnecting to the AP unlimited when the AP is really inexistent.

		config MDNS_HOSTNAME
			string "mDNS Hostname"
			default "esp32-server"
			help
				The mDNS host name used by the ESP32.

		config STATIC_IP
			bool "Enable Static IP Address"
			default false
			help
				Enable Static IP Address.

		config STATIC_IP_ADDRESS
			depends on STATIC_IP
			string "Static IP Address"
			default "192.168.10.100"
			help
				Static IP Address for Station.

		config STATIC_GW_ADDRESS
			depends on STATIC_IP
			string "Static GW Address"
			default "192.168.10.1"
			help
				Static GW Address for Station.

		config STATIC_NM_ADDRESS
			depends on STATIC_IP
			string "Static Netmask"
			default "255.255.255.0"
			help
				Static Netmask for Station.

	endmenu

	menu "Network Setting"

		choice NETWORK
			bool "Select Network protocol"
			default NETWORK_HTTP
			help
				Select Network protocol.
			config NETWORK_HTTP
				bool "Use HTTP protocol"
			config NETWORK_MQTT
				bool "Use MQTT protocol"
		endchoice

		config MQTT_BROKER
			depends on NETWORK_MQTT
			string "MQTT Broker"
			default "broker.emqx.io"
			help
				Host name or IP address of the broker to connect to.

		config MQTT_SUB_TOPIC
			depends on NETWORK_MQTT
			string "Subscribe Topic"
			default "/api/#"
			help
				Topic of publish.

	endmenu

endmenu
```
